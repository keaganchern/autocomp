## CMakeLists.txt
```
cmake_minimum_required(VERSION 3.20.0)

# rvv_bench_kb: parallel Zephyr app for KernelBench problems using PyTorch
# goldens for correctness. ExecuTorch is NOT linked here — the baseline cycle
# count is precomputed at extraction time and baked into src/data.h.
# Selected by saturn_eval when prob_type starts with "kb-rvv".
#
# Per-problem files (src/data.h, src/params.c) are generated by
# scripts/extract_kb_problem.py. main.c is overwritten on every build by
# saturn_eval with the harness + injected candidate code.

set(CONF_FILE prj.conf riscv_vector.conf)

find_package(Zephyr REQUIRED HINTS $ENV{ZEPHYR_BASE})
project(rvv_bench_kb)

target_include_directories(app PRIVATE ${CMAKE_CURRENT_SOURCE_DIR}/src)

target_sources(app PRIVATE
  src/main.c
  src/params.c
)

target_compile_options(app PRIVATE
  -march=rv64gcv
  -O3
  -ftree-vectorize
)
```

## prj.conf
```kconfig
CONFIG_THREAD_STACK_INFO=y
CONFIG_MP_MAX_NUM_CPUS=1
CONFIG_SMP=y
CONFIG_MAIN_STACK_SIZE=16384
CONFIG_THREAD_STACK_MEM_MAPPED=y
CONFIG_DYNAMIC_THREAD=y
CONFIG_DYNAMIC_THREAD_STACK_SIZE=16384
CONFIG_DYNAMIC_THREAD_ALLOC=y
CONFIG_RISCV_ISA_EXT_V=y

CONFIG_SCHED_CPU_MASK=y
CONFIG_SCHED_CPU_MASK_PIN_ONLY=n
CONFIG_SCHED_DUMB=y

CONFIG_POSIX_API=y
CONFIG_MULTITHREADING=y
CONFIG_POSIX_THREADS=y

CONFIG_FPU=y
CONFIG_HEAP_MEM_POOL_SIZE=1048576

CONFIG_GNU_C_EXTENSIONS=y
CONFIG_CPP=y
CONFIG_STD_C17=y
CONFIG_STD_CPP20=y
CONFIG_GLIBCXX_LIBCPP=y
CONFIG_PICOLIBC=y
CONFIG_COMMON_LIBC_MALLOC=y
CONFIG_COMMON_LIBC_MALLOC_ARENA_SIZE=67108864
```

## src/main.c
```c
/*
 * Placeholder main.c for rvv_bench_kb.
 *
 * This file is OVERWRITTEN on every build by saturn_eval.py with the harness +
 * autocomp candidate code (see _build_and_run_spike at saturn_eval.py:164).
 * The contents below only matter if the app is built directly without autocomp.
 *
 * Per-problem data files (data.h, model_pte.c, input_data.c) are populated by
 * scripts/extract_kb_problem.py before any autocomp run. Without that step,
 * the linker will pull in the empty placeholders shipped with this directory
 * and the binary will be non-functional — only useful as a CMake liveness check.
 */

#include <stdio.h>
#include <zephyr/sys/reboot.h>

int main(void) {
    printf("rvv_bench_kb placeholder — run scripts/extract_kb_problem.py first\n");
    sys_reboot(SYS_REBOOT_COLD);
    return 0;
}
```

## src/data.h
```c
/*
 * data.h — generated by scripts/extract_kb_problem.py.
 *
 * Input 0 shape: (1, 8, 16, 16)
 * Output shape: (1, 16, 14, 14)
 */

#pragma once

#include <stddef.h>

#define NUM_SETS                    5
#define NUM_INPUTS                  1
#define IN0_NUMEL                   2048
#define IN_NUMEL                    2048
#define OUT_NUMEL                   3136

/* Precomputed ExecuTorch+XNNPACK baseline (total cycles across NUM_SETS
 * invocations on this hardware config). The harness reports this as
 * iter-0's `ID 0 latency:` so beam-search keep_factor uses ExecuTorch's
 * actual cost as the reference. Override at extraction time via
 * `--baseline-cycles N`. */
#define BASELINE_EXECUTORCH_CYCLES  50000000

/* Per-set inputs (5 seeded random tensors per forward() arg). Each entry
 * is a pointer to a 16-byte-aligned byte array reinterpreted as float*. */
extern const float * const inputs0[NUM_SETS];

/* PyTorch-computed expected outputs (one per input set, baked at extraction
 * time via Model.forward()). The bit-exact correctness oracle in the harness. */
extern const float * const expected_outputs[NUM_SETS];

/* Model parameters (extracted from named_parameters(), in declaration order). */
extern const float * const conv_weight;  /* shape (16, 8, 3, 3), 4608 bytes */
extern const float * const conv_bias;  /* shape (16,), 64 bytes */
```
